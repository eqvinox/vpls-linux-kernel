## net/mpls/Kconfig
```kconfig
#
# MPLS configuration
#

menuconfig MPLS
	bool "MultiProtocol Label Switching"
	default n
	---help---
	  MultiProtocol Label Switching routes packets through logical
	  circuits.  Originally conceived as a way of routing packets at
	  hardware speeds (before hardware was capable of routing ipv4 packets),
	  MPLS remains a simple way of making tunnels.

	  If you have not heard of MPLS you probably want to say N here.

if MPLS

config NET_MPLS_GSO
	tristate "MPLS: GSO support"
	help
	 This is helper module to allow segmentation of non-MPLS GSO packets
	 that have had MPLS stack entries pushed onto them and thus
	 become MPLS GSO packets.

config MPLS_ROUTING
	tristate "MPLS: routing support"
	---help---
	 Add support for forwarding of mpls packets.

config MPLS_VPLS
	bool "VPLS support"
	default y
	depends on MPLS_ROUTING && BRIDGE_NETFILTER=n
	---help---
	 Add support for de-&encapsulating VPLS.  Not compatible with
	 bridge netfilter due to the latter stomping over VPLS' dst metadata.

comment "disable 'Bridged IP/ARP packets filtering' for VPLS support"
	depends on BRIDGE_NETFILTER

config MPLS_IPTUNNEL
	tristate "MPLS: IP over MPLS tunnel support"
	depends on LWTUNNEL && MPLS_ROUTING
	---help---
	 mpls ip tunnel support.

endif # MPLS
```
